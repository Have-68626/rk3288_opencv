## docs/bsp/defconfig/rk3288_defconfig
```kconfig
## RK3288 defconfig（临时基准）

本文件当前作为“文档审计对齐基准（临时）”，来源于设备运行态内核配置快照：
- `docs/bsp/kernel-config/kernel.config`
- Linux version: `4.4.143`

当你拿到厂商 BSP 源码后，应使用 BSP 原始 defconfig 替换本文件，以提高一致性审计的可信度。

## 文档审计对齐项（从运行态配置提取）
CONFIG_IKCONFIG=y
CONFIG_IKCONFIG_PROC=y

CONFIG_CGROUPS=y
CONFIG_NAMESPACES=y
CONFIG_SECCOMP=y

CONFIG_NET=y
CONFIG_INET=y
CONFIG_IPV6=y
CONFIG_BRIDGE=y

CONFIG_BT=y
CONFIG_CFG80211=y
CONFIG_MAC80211=y
CONFIG_RFKILL=y

CONFIG_MEDIA_SUPPORT=y
CONFIG_MEDIA_CAMERA_SUPPORT=y
CONFIG_MEDIA_CONTROLLER=y
CONFIG_MEDIA_USB_SUPPORT=y

CONFIG_VIDEO_V4L2=y
CONFIG_VIDEOBUF2_CORE=y
CONFIG_VIDEOBUF2_MEMOPS=y
CONFIG_VIDEOBUF2_VMALLOC=y
CONFIG_USB_VIDEO_CLASS=y
CONFIG_USB_VIDEO_CLASS_INPUT_EVDEV=y

CONFIG_DRM=y
CONFIG_DRM_ROCKCHIP=y
CONFIG_FB=y
CONFIG_MALI_DT=y
CONFIG_MALI_DEVFREQ=y
CONFIG_MALI_MIDGARD=y
CONFIG_MALI_PLATFORM_THIRDPARTY=y
CONFIG_MALI_PLATFORM_THIRDPARTY_NAME="rk"
CONFIG_ROCKCHIP_RGA=y
CONFIG_ROCKCHIP_RGA2=y
CONFIG_RK_VCODEC=y

CONFIG_USB=y
CONFIG_USB_EHCI_HCD=y
CONFIG_USB_OHCI_HCD=y
CONFIG_USB_STORAGE=y

CONFIG_ASHMEM=y
CONFIG_ION=y
CONFIG_ANDROID=y

CONFIG_SECURITY_SELINUX=y

CONFIG_EXT4_FS=y
CONFIG_TMPFS=y
```
